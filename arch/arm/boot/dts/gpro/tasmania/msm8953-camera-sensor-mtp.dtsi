&cci {
    qcom,camera@0 {
		qcom,cam-vreg-min-voltage = <0 1200000 2850000 2800000 1220000>;
		qcom,cam-vreg-max-voltage = <0 1200000 2850000 2800000 1220000>;
        qcom,cam-vreg-op-mode = <0 200000 100000 80000 105000>;
        gpios = <&tlmm 26 0>,
                <&tlmm 39 0>,
                <&tlmm 39 0>,
                <&tlmm 134 0>;
    };
};

