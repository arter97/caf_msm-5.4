&i2c_5 {
        status = "okay";
        focaltech@38 {
                compatible = "focaltech,5x06";
                reg = <0x38>;
                interrupt-parent = <&tlmm>;
                interrupts = <65 0x2>;
                vdd-supply = <&pm8953_l8>;
                vcc_i2c-supply = <&pm8953_l5>;
                /* pins used by touchscreen */
                pinctrl-names = "pmx_ts_active","pmx_ts_suspend",
                                                "pmx_ts_release";
                pinctrl-0 = <&ts_int_active &ts_reset_active>;
                pinctrl-1 = <&ts_int_suspend &ts_reset_suspend>;
                pinctrl-2 = <&ts_release>;
                focaltech,name = "ft5x06_ts";
                focaltech,family-id = <0x06>;
                focaltech,reset-gpio = <&tlmm 64 0x0>;
                focaltech,irq-gpio = <&tlmm 65 0x2008>;
                focaltech,display-coords = <0 0 320 480>;
                focaltech,panel-coords = <0 0 320 480>;
                focaltech,no-force-update;
                focaltech,i2c-pull-up;
                focaltech,group-id = <1>;
                focaltech,hard-reset-delay-ms = <20>;
                focaltech,soft-reset-delay-ms = <200>;
                focaltech,num-max-touches = <5>;
                focaltech,fw-delay-aa-ms = <30>;
                focaltech,fw-delay-55-ms = <30>;
                focaltech,fw-upgrade-id1 = <0x79>;
                focaltech,fw-upgrade-id2 = <0x08>;
                focaltech,fw-delay-readid-ms = <10>;
                focaltech,fw-delay-era-flsh-ms = <2000>;
                focaltech,fw-auto-cal;
                focaltech,resume-in-workqueue;
        };
};
