qcom,3064350_gopro_tasmaniaatl_1160mah_averaged_masterslave_aug14th2017 {
	/* #3064350_GoPro_TasmaniaATL_1160mAh_averaged_MasterSlave_Aug14th2017*/
	qcom,max-voltage-uv = <4350000>;
	qcom,nom-batt-capacity-mah = <1160>;
	qcom,batt-id-kohm = <100>;
	qcom,battery-beta = <3435>;
	qcom,battery-type = "3064350_gopro_tasmaniaatl_1160mah_averaged_masterslave_aug14th2017";
	qcom,chg-rslow-comp-c1 = <2690832>;
	qcom,chg-rslow-comp-c2 = <3466417>;
	qcom,chg-rs-to-rslow = <952070>;
	qcom,chg-rslow-comp-thr = <0x9D>;
	qcom,chg-term-ua = <50000>;
	qcom,fastchg_threshold = <3000>;
	qcom,checksum = <0x2D0A>;
	qcom,gui-version = "PMI8950GUI - 2.0.0.16";
	qcom,fg-profile-data = [
		EE 83 23 7D
		0E 81 19 77
		65 83 21 74
		C2 88 42 8F
		57 82 9A 93
		9A B4 43 BB
		5D 13 0C 88
		3C 7E CF 81
		3D 7C 4D 83
		AA 70 46 40
		56 7C 3B 82
		F4 99 3A BD
		52 CA 61 0E
		B0 04 1D 62
		14 70 5D FE
		FB 3D 02 3F
		DE 33 00 00
		F9 46 04 21
		3F 39 00 00
		00 00 00 00
		00 00 00 00
		64 70 EB 6B
		1A 68 2F 82
		35 6C 99 62
		68 49 17 78
		64 66 13 61
		D8 8E C3 C1
		0E 65 62 B1
		5E A0 71 0C
		28 00 FF 36
		F0 11 30 03
		00 00 00 0C
		];
};
