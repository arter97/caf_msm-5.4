/* Copyright (c) 2013, The Linux Foundation. All rights reserved.
 *
 * This program is free software; you can redistribute it and/or modify
 * it under the terms of the GNU General Public License version 2 and
 * only version 2 as published by the Free Software Foundation.
 *
 * This program is distributed in the hope that it will be useful,
 * but WITHOUT ANY WARRANTY; without even the implied warranty of
 * MERCHANTABILITY or FITNESS FOR A PARTICULAR PURPOSE.  See the
 * GNU General Public License for more details.
 */

/*---------------------------------------------------------------------------
 * This file is autogenerated file using gcdb parser. Please do not edit it.
 * Update input XML file to add a new entry or update variable in this file
 * VERSION = "1.0"
 *---------------------------------------------------------------------------*/
&mdss_mdp {
	dsi_himax8394a_720_vid: qcom,mdss_dsi_himax8394a_720p_video {
		qcom,mdss-dsi-panel-name = "himax8394a 720p video mode dsi panel";
		qcom,mdss-dsi-panel-controller = <&mdss_dsi0>;
		qcom,mdss-dsi-panel-type = "dsi_video_mode";
		qcom,mdss-dsi-panel-destination = "display_1";
		qcom,mdss-dsi-panel-framerate = <60>;
		qcom,mdss-dsi-virtual-channel-id = <0>;
		qcom,mdss-dsi-stream = <0>;
		qcom,mdss-dsi-panel-width = <720>;
		qcom,mdss-dsi-panel-height = <1280>;
		qcom,mdss-dsi-h-front-porch = <79>;
		qcom,mdss-dsi-h-back-porch = <59>;
		qcom,mdss-dsi-h-pulse-width = <60>;
		qcom,mdss-dsi-h-sync-skew = <0>;
		qcom,mdss-dsi-v-back-porch = <10>;
		qcom,mdss-dsi-v-front-porch = <7>;
		qcom,mdss-dsi-v-pulse-width = <2>;
		qcom,mdss-dsi-h-left-border = <0>;
		qcom,mdss-dsi-h-right-border = <0>;
		qcom,mdss-dsi-v-top-border = <0>;
		qcom,mdss-dsi-v-bottom-border = <0>;
		qcom,mdss-dsi-bpp = <24>;
		qcom,mdss-dsi-color-order = <0>;
		qcom,mdss-dsi-underflow-color = <0xff>;
		qcom,mdss-dsi-border-color = <0>;
		qcom,mdss-dsi-pixel-packing = <0>;
		qcom,mdss-dsi-on-command = [39 01 00 00 00 00 04
				B9 FF 83 94
			39 01 00 00 00 00 02
				53 24
			39 01 00 00 05 00 02
				55 01
			39 01 00 00 00 00 11
				BA 13 82 00 16 c5 00 10
				ff 0f 24 03 21 24 25 20
				08
			39 01 00 00 0a 00 10
				B1 01 00 37 8a 01 12 12
				2C 34 2b 2b 57 02 00 E6
			39 01 00 00 00 00 03
				BF 06 02
			39 01 00 00 00 00 07
				B2 00 C8 0E 30 00 22
			39 01 00 00 00 00 03
				B0 01 0A
			39 01 00 00 00 00 20
				B4 80 08 32 10 06 32 10
				01 22 10 08 38 07 52 0c
				37 00 5F 0A 6F 6F 0A 06
				44 06 5F 0A 6B 70 05 08
			39 01 00 00 00 00 3f
				D5 00 00 00 00 0A 00 01
				22 00 00 33 00 23 01 67
				45 01 23 88 88 88 88 88
				88 88 88 88 88 88 45 99
				88 54 76 10 32 32 10 88
				88 88 88 88 88 88 88 88
				88 88 54 99 88 3C 0A 00
				00 00 00 00 00 00 00
			39 01 00 00 00 00 02
				B6 15
			39 01 00 00 00 00 02
				C6 08
			39 01 00 00 00 00 02
				BC 07
			39 01 00 00 00 00 2b
				E0 00 1a 22 2F 2D 3f 32
				4b 09 10 10 13 16 14 15
				11 18 00 1a 22 2F 2D 3f
				32 4b 09 10 10 13 16 14
				15 11 18 0d 18 08 10 0d
				18 08 10
			39 01 00 00 00 00 02
				CC 09
			39 01 00 00 00 00 02
				3A 70
			39 01 00 00 00 00 05
				C7 00 10 00 10
			39 01 00 00 00 00 03
				BF 06 02
			05 01 00 00 64 00 02
				11 00
			05 01 00 00 00 00 02
				29 00];
		qcom,mdss-dsi-off-command = [05 01 00 00 32 00 02 28 00
					05 01 00 00 78 00 02 10 00];
		qcom,mdss-dsi-on-command-state = "dsi_lp_mode";
		qcom,mdss-dsi-off-command-state = "dsi_hs_mode";
		qcom,mdss-dsi-h-sync-pulse = <1>;
		qcom,mdss-dsi-traffic-mode = <2>;
		qcom,mdss-dsi-lane-map = <0>;
		qcom,mdss-dsi-bllp-eof-power-mode;
		qcom,mdss-dsi-bllp-power-mode;
		qcom,mdss-dsi-lane-0-state;
		qcom,mdss-dsi-lane-1-state;
		qcom,mdss-dsi-lane-2-state;
		qcom,mdss-dsi-lane-3-state;
		qcom,mdss-dsi-panel-timings = [8d 24 19 00 34 34 1d 26 2a 03 04 00];
		qcom,mdss-dsi-t-clk-post = <0x20>;
		qcom,mdss-dsi-t-clk-pre = <0x2D>;
		qcom,mdss-dsi-bl-min-level = <1>;
		qcom,mdss-dsi-bl-max-level = <255>;
		qcom,mdss-dsi-dma-trigger = <4>;
		qcom,mdss-dsi-mdp-trigger = <0>;
		qcom,mdss-dsi-bl-pmic-control-type = "bl_ctrl_dcs";

	};
};
