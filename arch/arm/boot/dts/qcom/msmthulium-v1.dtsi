/* Copyright (c) 2014-2015, The Linux Foundation. All rights reserved.
 *
 * This program is free software; you can redistribute it and/or modify
 * it under the terms of the GNU General Public License version 2 and
 * only version 2 as published by the Free Software Foundation.
 *
 * This program is distributed in the hope that it will be useful,
 * but WITHOUT ANY WARRANTY; without even the implied warranty of
 * MERCHANTABILITY or FITNESS FOR A PARTICULAR PURPOSE.  See the
 * GNU General Public License for more details.
 */

/*
 * As a general rule, only version-specific property overrides should be placed
 * inside this file. Common device definitions should be placed inside the
 * msmthulium.dtsi file.
 */

#include "msmthulium.dtsi"

/ {
	model = "Qualcomm Technologies, Inc. MSM THULIUM v1";
	qcom,msm-id = <246 0x10000>;
};

&l2ccc_1 {
	qcom,cbf-clock-seq;
};

&msm_vidc {
	qcom,firmware-name = "venus-v1";
};
