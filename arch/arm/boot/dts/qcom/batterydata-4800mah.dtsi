/*
 * Copyright (c) 2017, The Linux Foundation. All rights reserved.
 *
 * This program is free software; you can redistribute it and/or modify
 * it under the terms of the GNU General Public License version 2 and
 * only version 2 as published by the Free Software Foundation.
 *
 * This program is distributed in the hope that it will be useful,
 * but WITHOUT ANY WARRANTY; without even the implied warranty of
 * MERCHANTABILITY or FITNESS FOR A PARTICULAR PURPOSE.  See the
 * GNU General Public License for more details.
 */

qcom,rugged-4v35-4800mah {
	qcom,fcc-mah = <4800>;
	qcom,default-rbatt-mohm = <106>;
	qcom,max-voltage-uv = <4350000>;
	qcom,rbatt-capacitive-mohm = <50>;
	qcom,v-cutoff-uv = <3500000>;
	qcom,chg-term-ua = <200000>;
	qcom,batt-id-kohm = <10>;

	qcom,fcc-temp-lut {
		qcom,lut-col-legend = <(-20) 0 25 40 60>;
		qcom,lut-data = <4620 4670 4643 4639 4573>;
	};

	qcom,pc-temp-ocv-lut {
		qcom,lut-col-legend = <(-20) 0 25 40 60>;
		qcom,lut-row-legend = <100 95 90 85 80>,
				<75 70 65 60 55>,
				<50 45 40 35 30>,
				<25 20 16 13 11>,
				<10 9 8 7 6>,
				<5 4 3 2 1>,
				<0>;
		qcom,lut-data = <4309 4316 4303 4314 4304>,
				<4174 4234 4239 4246 4239>,
				<4089 4173 4182 4188 4182>,
				<4016 4117 4128 4133 4128>,
				<3952 4065 4077 4081 4077>,
				<3898 4011 4029 4033 4030>,
				<3850 3958 3984 3989 3986>,
				<3809 3909 3939 3948 3945>,
				<3774 3867 3887 3894 3895>,
				<3739 3833 3848 3854 3854>,
				<3704 3804 3821 3826 3826>,
				<3669 3782 3800 3803 3804>,
				<3635 3766 3782 3786 3785>,
				<3603 3748 3767 3767 3763>,
				<3572 3725 3750 3747 3736>,
				<3541 3691 3724 3723 3711>,
				<3503 3653 3692 3693 3681>,
				<3466 3617 3669 3672 3664>,
				<3430 3579 3649 3661 3647>,
				<3396 3537 3611 3625 3619>,
				<3379 3509 3588 3606 3594>,
				<3357 3478 3557 3575 3565>,
				<3333 3444 3521 3543 3533>,
				<3305 3406 3478 3502 3493>,
				<3270 3363 3430 3454 3448>,
				<3230 3316 3379 3401 3398>,
				<3185 3265 3327 3347 3345>,
				<3137 3212 3273 3290 3284>,
				<3089 3153 3208 3220 3206>,
				<3044 3085 3122 3123 3105>,
				<3000 3000 3000 3000 3000>;
	};

	qcom,rbatt-sf-lut {
		qcom,lut-col-legend = <(-20) 0 25 40 60>;
		qcom,lut-row-legend = <100 95 90 85 80>,
				<75 70 65 60 55>,
				<50 45 40 35 30>,
				<25 20 16 13 11>,
				<10 9 8 7 6>,
				<5 4 3 2 1>,
				<0>;
		qcom,lut-data = <1016 292 100 77 89>,
				<969 291 100 78 87>,
				<973 292 100 78 88>,
				<934 294 101 79 87>,
				<909 300 104 81 87>,
				<895 299 108 82 89>,
				<888 290 116 86 90>,
				<891 277 125 93 95>,
				<898 268 108 86 90>,
				<904 267 100 81 85>,
				<915 270 100 81 85>,
				<933 279 100 81 86>,
				<966 295 100 83 86>,
				<1023 314 102 83 86>,
				<1105 329 102 81 84>,
				<1215 329 102 81 84>,
				<1360 336 105 82 84>,
				<1500 366 111 84 86>,
				<1616 398 127 89 90>,
				<1839 408 149 104 98>,
				<1962 407 159 111 103>,
				<2154 403 167 116 108>,
				<2395 391 173 121 113>,
				<2558 393 172 125 118>,
				<2849 416 176 131 123>,
				<3431 459 191 139 133>,
				<4298 525 216 152 142>,
				<5552 634 250 169 155>,
				<7372 852 295 193 181>,
				<9899 1468 410 262 292>,
				<13550 3492 2325 965 1512>;
	};
};
