/* Copyright (c) 2015, The Linux Foundation. All rights reserved.
 *
 * This program is free software; you can redistribute it and/or modify
 * it under the terms of the GNU General Public License version 2 and
 * only version 2 as published by the Free Software Foundation.
 *
 * This program is distributed in the hope that it will be useful,
 * but WITHOUT ANY WARRANTY; without even the implied warranty of
 * MERCHANTABILITY or FITNESS FOR A PARTICULAR PURPOSE.  See the
 * GNU General Public License for more details.
 */

/*---------------------------------------------------------------------------
 * This file is autogenerated file using gcdb parser. Please do not edit it.
 * Update input XML file to add a new entry or update variable in this file
 * VERSION = "1.0"
 *---------------------------------------------------------------------------*/
&mdss_mdp {
	dsi_otm1906c_1080p_cmd: qcom,mdss_dsi_otm1906c_1080p_cmd {
		qcom,mdss-dsi-panel-name = "otm1906c 1080p cmd mode dsi panel";
		qcom,mdss-dsi-panel-controller = <&mdss_dsi0>;
		qcom,mdss-dsi-panel-type = "dsi_cmd_mode";
		qcom,mdss-dsi-panel-destination = "display_1";
		qcom,mdss-dsi-panel-framerate = <60>;
		qcom,mdss-dsi-virtual-channel-id = <0>;
		qcom,mdss-dsi-stream = <0>;
		qcom,mdss-dsi-panel-width = <1080>;
		qcom,mdss-dsi-panel-height = <1920>;
		qcom,mdss-dsi-h-front-porch = <20>;
		qcom,mdss-dsi-h-back-porch = <10>;
		qcom,mdss-dsi-h-pulse-width = <2>;
		qcom,mdss-dsi-h-sync-skew = <0>;
		qcom,mdss-dsi-v-back-porch = <16>;
		qcom,mdss-dsi-v-front-porch = <12>;
		qcom,mdss-dsi-v-pulse-width = <1>;
		qcom,mdss-dsi-h-left-border = <0>;
		qcom,mdss-dsi-h-right-border = <0>;
		qcom,mdss-dsi-v-top-border = <0>;
		qcom,mdss-dsi-v-bottom-border = <0>;
		qcom,mdss-dsi-bpp = <24>;
		qcom,mdss-dsi-underflow-color = <0xff>;
		qcom,mdss-dsi-border-color = <0>;
		qcom,mdss-dsi-on-command = [29 01 00 00 00 00 02 00 00
			29 01 00 00 00 00 04 FF 19 06 01
			29 01 00 00 00 00 02 00 80
			29 01 00 00 00 00 03 FF 19 06
			29 01 00 00 00 00 02 00 A0
			29 01 00 00 00 00 04 C1 00 c0 10
			29 01 00 00 00 00 02 00 80
			29 01 00 00 00 00 02 C4 81
			29 01 00 00 00 00 02 00 91
			29 01 00 00 00 00 03 c5 14 28
			29 01 00 00 00 00 02 00 95
			29 01 00 00 00 00 02 C5 11
			29 01 00 00 00 00 02 00 81
			29 01 00 00 00 00 02 a5 01
			29 01 00 00 00 00 02 00 a5
			29 01 00 00 00 00 02 c5 11
			29 01 00 00 00 00 02 00 90
			29 01 00 00 00 00 05 F5 09 16 09 16
			29 01 00 00 00 00 02 00 A7
			29 01 00 00 00 00 02 F5 1A
			29 01 00 00 00 00 02 00 9D
			29 01 00 00 00 00 02 F5 1A
			29 01 00 00 00 00 02 00 A5
			29 01 00 00 00 00 02 F5 16
			29 01 00 00 00 00 02 00 8D
			29 01 00 00 00 00 02 F5 17
			29 01 00 00 00 00 02 00 E3
			29 01 00 00 00 00 02 F5 11
			29 01 00 00 00 00 02 00 ED
			29 01 00 00 00 00 02 F5 16
			29 01 00 00 00 00 02 00 E5
			29 01 00 00 00 00 02 F5 16
			29 01 00 00 00 00 02 00 81
			29 01 00 00 00 00 02 F5 16
			29 01 00 00 00 00 02 00 83
			29 01 00 00 00 00 02 F5 16
			29 01 00 00 00 00 02 00 E1
			29 01 00 00 00 00 02 F5 16
			29 01 00 00 00 00 02 00 80
			29 01 00 00 00 00 0d D8 80 00 00 80 80 80 81 81 81 80 81 81
			29 01 00 00 00 00 02 00 90
			29 01 00 00 00 00 0d D8 00 00 00 80 81 81 81 81 82 82 83 84
			29 01 00 00 00 00 02 00 A0
			29 01 00 00 00 00 0d D8 00 01 02 02 04 05 06 08 0a 18 40 68
			29 01 00 00 00 00 02 00 B0
			29 01 00 00 00 00 0d D8 00 80 80 81 82 83 83 84 85 87 8e 95
			29 01 00 00 00 00 02 00 C0
			29 01 00 00 00 00 0d D8 82 83 83 85 87 8b 8d 91 93 93 97 9b
			29 01 00 00 00 00 02 00 D0
			29 01 00 00 00 00 0d D8 01 02 02 02 04 05 06 08 09 0a 15 20
			29 01 00 00 00 00 02 00 C0
			29 01 00 00 00 00 05 D7 82 80 C0 FF
			29 01 00 00 00 00 02 00 00
			29 01 00 00 00 00 09 d9 00 b4 00 b4 00 b4 00 b4
			29 01 00 00 00 00 02 00 80
			29 01 00 00 00 00 03 c1 55 55
			29 01 00 00 00 00 02 00 94
			29 01 00 00 00 00 02 c5 88
			29 01 00 00 00 00 02 00 a4
			29 01 00 00 00 00 02 c5 88
			29 01 00 00 00 00 02 00 b3
			29 01 00 00 00 00 02 c0 88
			29 01 00 00 00 00 02 00 00
			29 01 00 00 00 00 03 d8 23 23
			29 01 00 00 00 00 02 00 a0
			29 01 00 00 00 00 02 b3 33
			29 01 00 00 00 00 02 00 a6
			29 01 00 00 00 00 02 b3 30
			29 01 00 00 00 00 02 00 C1
			29 01 00 00 00 00 02 C5 f5
			29 01 00 00 00 00 02 00 e0
			29 01 00 00 00 00 0b B4 1c 19 3f 01 64 5c 01 a0 5f a0
			29 01 00 00 00 00 02 00 f0
			29 01 00 00 00 00 02 b4 64
			29 01 00 00 00 00 02 00 80
			29 01 00 00 00 00 0f c0 00 71 00 0a 0a 00 71 0a 0a 00 71 00 0a 0a
			29 01 00 00 00 00 02 00 90
			29 01 00 00 00 00 07 c0 00 00 00 02 00 04
			29 01 00 00 00 00 02 00 a0
			29 01 00 00 00 00 10 c0 00 00 02 00 04 15 04 00 00 00 00 00 00 00 00
			29 01 00 00 00 00 02 00 d0
			29 01 00 00 00 00 10 c0 00 00 02 00 04 15 04 00 00 00 00 00 00 00 00
			29 01 00 00 00 00 02 00 80
			29 01 00 00 00 00 0d c2 83 01 00 00 82 01 00 00 00 00 00 00
			29 01 00 00 00 00 02 00 90
			29 01 00 00 00 00 0d c2 00 00 00 00 00 00 00 00 00 00 00 00
			29 01 00 00 00 00 02 00 a0
			29 01 00 00 00 00 0e c2 00 00 00 00 00 00 00 00 00 00 00 00 00
			29 01 00 00 00 00 02 00 b0
			29 01 00 00 00 00 10 c2 82 02 00 00 88 81 02 00 00 88 00 02 00 00 88
			29 01 00 00 00 00 02 00 c0
			29 01 00 00 00 00 10 c2 01 02 00 00 88 00 00 00 00 00 00 00 00 00 00
			29 01 00 00 00 00 02 00 d0
			29 01 00 00 00 00 10 c2 00 00 00 00 00 00 00 00 00 00 33 33 33 33 00
			29 01 00 00 00 00 02 00 80
			29 01 00 00 00 00 10 c3 00 00 00 00 00 00 00 00 00 00 00 00 00 00 00
			29 01 00 00 00 00 02 00 a0
			29 01 00 00 00 00 0d c3 83 01 00 00 82 01 00 00 00 00 00 00
			29 01 00 00 00 00 02 00 b0
			29 01 00 00 00 00 0f c3 00 00 00 00 82 02 00 00 88 81 02 00 00 88
			29 01 00 00 00 00 02 00 c0
			29 01 00 00 00 00 10 c3 00 02 00 00 88 01 02 00 00 88 00 00 00 00 00
			29 01 00 00 00 00 02 00 d0
			29 01 00 00 00 00 10 c3 00 00 00 00 00 00 00 00 00 00 00 00 00 00 00
			29 01 00 00 00 00 02 00 e0
			29 01 00 00 00 00 06 c3 33 33 33 33 00
			29 01 00 00 00 00 02 00 80
			29 01 00 00 00 00 0c cb 00 00 00 00 30 00 03 00 00 00 70
			29 01 00 00 00 00 02 00 90
			29 01 00 00 00 00 10 cb 00 00 00 00 00 00 00 00 00 00 00 00 00 00 00
			29 01 00 00 00 00 02 00 a0
			29 01 00 00 00 00 10 cb 00 00 00 bf 00 00 00 00 00 ff 00 00 00 00 00
			29 01 00 00 00 00 02 00 b0
			29 01 00 00 00 00 0d cb 00 00 00 00 00 00 00 00 00 00 77 77
			29 01 00 00 00 00 02 00 c0
			29 01 00 00 00 00 10 cb 01 01 01 01 01 01 01 01 01 01 01 01 01 01 01
			29 01 00 00 00 00 02 00 d0
			29 01 00 00 00 00 10 cb 01 01 01 f3 01 01 01 01 00 f3 00 00 01 00 01
			29 01 00 00 00 00 02 00 e0
			29 01 00 00 00 00 0d cb 00 01 00 01 00 01 00 01 00 00 77 07
			29 01 00 00 00 00 02 00 f0
			29 01 00 00 00 00 0c cb ff ff ff ff ff ff 03 33 03 00 70
			29 01 00 00 00 00 02 00 80
			29 01 00 00 00 00 0d cc 09 08 19 18 0f 0e 0d 0c 07 07 07 07
			29 01 00 00 00 00 02 00 90
			29 01 00 00 00 00 0d cc 08 09 18 19 0c 0d 0e 0f 07 07 07 07
			29 01 00 00 00 00 02 00 a0
			29 01 00 00 00 00 10 cc 14 15 16 17 1c 1d 1e 1f 01 04 20 07 07 07 00
			29 01 00 00 00 00 02 00 b0
			29 01 00 00 00 00 0a cc 01 02 03 04 05 06 07 07 00
			29 01 00 00 00 00 02 00 C0
			29 01 00 00 00 00 10 CC 0c 0c 00 00 0c 0c 0c 0c 00 00 00 00 00 00 00
			29 01 00 00 00 00 02 00 D0
			29 01 00 00 00 00 10 CC 00 00 00 00 00 00 00 00 00 00 00 33 33 33 33
			29 01 00 00 00 00 02 00 E0
			29 01 00 00 00 00 10 CC 33 33 00 00 00 00 00 00 00 00 00 00 00 00 00
			29 01 00 00 00 00 02 00 80
			29 01 00 00 00 00 10 cd 1a 01 12 11 1a 05 18 07 1a 1a 23 23 23 1f 1e
			29 01 00 00 00 00 02 00 90
			29 01 00 00 00 00 04 cd 1d 23 23
			29 01 00 00 00 00 02 00 a0
			29 01 00 00 00 00 10 cd 1a 02 12 11 1a 06 18 08 1a 1a 23 23 23 1f 1e
			29 01 00 00 00 00 02 00 b0
			29 01 00 00 00 00 04 cd 1d 23 23
			29 01 00 00 00 00 02 00 80
			29 01 00 00 00 00 0b A4 AF 00 20 04 00 17 15 03 60 00
			29 01 00 00 00 00 02 00 90
			29 01 00 00 00 00 04 A4 00 00 00
			29 01 00 00 00 00 02 00 80
			29 01 00 00 00 00 0d A7 ff 0f 1e 00 1f 00 01 98 00 00 00 00
			29 01 00 00 00 00 02 00 90
			29 01 00 00 00 00 0b A7 1c 1f 3b 00 00 be 90 ce 05 f0
			29 01 00 00 00 00 02 00 A0
			29 01 00 00 00 00 02 A7 30
			29 01 00 00 00 00 02 00 B0
			29 01 00 00 00 00 06 A7 01 1e 1f 00 00
			29 01 00 00 00 00 02 00 C0
			29 01 00 00 00 00 0d A7 ff 0f 1e 00 1e 00 01 18 00 00 00 00
			29 01 00 00 00 00 02 00 D0
			29 01 00 00 00 00 0b A7 ff ff 1c 00 01 7c 81 7c 0b e0
			29 01 00 00 00 00 02 00 E0
			29 01 00 00 00 00 02 A7 30
			29 01 00 00 00 00 02 00 F0
			29 01 00 00 00 00 06 A7 01 3d 3e 00 00
			29 01 00 00 00 00 02 00 80
			29 01 00 00 00 00 0d A9 00 00 00 00 00 00 00 00 00 00 00 00
			29 01 00 00 00 00 02 00 90
			29 01 00 00 00 00 0b A9 00 00 00 00 00 00 00 00 00 00
			29 01 00 00 00 00 02 00 A0
			29 01 00 00 00 00 02 A9 00
			29 01 00 00 00 00 02 00 B0
			29 01 00 00 00 00 06 A9 00 00 00 00 00
			29 01 00 00 00 00 02 00 C0
			29 01 00 00 00 00 0f A9 ff 3a 49 00 1e 00 01 00 00 00 00 00 00 77
			29 01 00 00 00 00 02 00 D0
			29 01 00 00 00 00 0b A9 ff ff 1d 00 01 7c 81 7c 0b e0
			29 01 00 00 00 00 02 00 E0
			29 01 00 00 00 00 02 A9 30
			29 01 00 00 00 00 02 00 F0
			29 01 00 00 00 00 06 A9 00 3c 3c 00 00
			29 01 00 00 00 00 02 00 B0
			29 01 00 00 00 00 09 A4 05 f0 0b e0 00 00 0b e0
			29 01 00 00 00 00 02 00 80
			29 01 00 00 00 00 10 AB 05 14 00 00 ff 6a 00 00 00 00 00 00 00 00 00
			29 01 00 00 00 00 02 00 A0
			29 01 00 00 00 00 10 AB 00 00 00 00 00 00 00 07 00 00 00 00 01 00 00
			29 01 00 00 00 00 02 00 B0
			29 01 00 00 00 00 0d AB 00 00 68 01 01 00 44 04 00 00 00 00
			29 01 00 00 00 00 02 00 93
			29 01 00 00 00 00 02 b3 01
			29 01 00 00 00 00 02 00 80
			29 01 00 00 00 00 08 ce 00 00 00 00 00 00 00
			29 01 00 00 00 00 02 00 87
			29 01 00 00 00 00 08 ce 00 00 33 00 33 00 00
			29 01 00 00 00 00 02 00 f0
			29 01 00 00 00 00 05 ce 00 00 00 00
			29 01 00 00 00 00 02 00 90
			29 01 00 00 00 00 10 ce 00 00 00 f0 00 00 00 00 fc 00 fc 00 00 00 00
			29 01 00 00 00 00 02 00 a0
			29 01 00 00 00 00 08 ce 00 00 40 40 40 00 00
			29 01 00 00 00 00 02 00 b0
			29 01 00 00 00 00 10 ce 01 01 01 01 01 01 01 01 f1 01 f1 01 01 01 01
			29 01 00 00 00 00 02 00 c0
			29 01 00 00 00 00 08 ce 01 01 01 01 01 01 01
			29 01 00 00 00 00 02 00 d0
			29 01 00 00 00 00 10 ce 04 04 04 04 04 04 04 04 f7 04 f7 04 04 00 00
			29 01 00 00 00 00 02 00 e0
			29 01 00 00 00 00 08 ce 00 00 15 15 15 04 04
			29 01 00 00 00 00 02 00 f4
			29 01 00 00 00 00 02 ce 25
			29 01 00 00 00 00 02 00 80
			29 01 00 00 00 00 03 FF 00 00
			29 01 00 00 00 00 02 00 00
			29 01 00 00 00 00 04 FF 00 00 00
			29 01 00 00 00 00 02 35 00
			29 01 00 00 00 00 02 51 ff
			29 01 00 00 00 00 02 53 24
			29 01 00 00 78 00 02 11 00
			29 01 00 00 78 00 02 29 00];

		qcom,mdss-dsi-off-command = [05 01 00 00 00 00 02 28 00
					05 01 00 00 78 00 02 10 00];
		qcom,mdss-dsi-on-command-state = "dsi_lp_mode";
		qcom,mdss-dsi-off-command-state = "dsi_hs_mode";
		qcom,mdss-dsi-h-sync-pulse = <1>;
		qcom,mdss-dsi-traffic-mode = "burst_mode";
		qcom,mdss-dsi-lane-map = "lane_map_0123";
		qcom,mdss-dsi-bllp-eof-power-mode;
		qcom,mdss-dsi-bllp-power-mode;
		qcom,mdss-dsi-lp11-init;
		qcom,mdss-dsi-init-delay-us = <5>;
		qcom,mdss-dsi-lane-0-state;
		qcom,mdss-dsi-lane-1-state;
		qcom,mdss-dsi-lane-2-state;
		qcom,mdss-dsi-lane-3-state;
		qcom,mdss-dsi-te-pin-select = <1>;
		qcom,mdss-dsi-wr-mem-start = <0x2c>;
		qcom,mdss-dsi-te-dcs-command = <1>;
		qcom,mdss-dsi-te-check-enable;
		qcom,mdss-dsi-te-using-te-pin;
		qcom,mdss-dsi-panel-timings = [32 30 20 00 5E 62 26 34 26 03 04 00];
		qcom,mdss-dsi-t-clk-post = <0x03>;
		qcom,mdss-dsi-t-clk-pre = <0x15>;
		qcom,mdss-dsi-dma-trigger = "trigger_sw";
		qcom,mdss-dsi-mdp-trigger = "none";
		qcom,mdss-dsi-bl-pmic-control-type = "bl_ctrl_wled";
		qcom,mdss-dsi-bl-min-level = <1>;
		qcom,mdss-dsi-bl-max-level = <4095>;
		qcom,mdss-dsi-reset-sequence = <1 1>, <0 50>, <1 50>;
	};
};
