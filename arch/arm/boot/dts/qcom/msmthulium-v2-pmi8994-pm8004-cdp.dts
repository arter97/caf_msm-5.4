/* Copyright (c) 2015, The Linux Foundation. All rights reserved.
 *
 * This program is free software; you can redistribute it and/or modify
 * it under the terms of the GNU General Public License version 2 and
 * only version 2 as published by the Free Software Foundation.
 *
 * This program is distributed in the hope that it will be useful,
 * but WITHOUT ANY WARRANTY; without even the implied warranty of
 * MERCHANTABILITY or FITNESS FOR A PARTICULAR PURPOSE.  See the
 * GNU General Public License for more details.
 */

/dts-v1/;

#include "msmthulium-v2.dtsi"
#include "msmthulium-pm8994-pmi8994-pm8004.dtsi"
#include "msmthulium-cdp.dtsi"

/ {
	model = "Qualcomm Technologies, Inc. MSM THULIUM v2 + PMI8994 + PM8004 CDP";
	compatible = "qcom,msmthulium-cdp", "qcom,msmthulium", "qcom,cdp";
	qcom,board-id = <1 0>;
};
