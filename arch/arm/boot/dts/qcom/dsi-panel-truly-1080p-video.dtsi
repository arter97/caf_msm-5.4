/* Copyright (c) 2015, The Linux Foundation. All rights reserved.
 *
 * This program is free software; you can redistribute it and/or modify
 * it under the terms of the GNU General Public License version 2 and
 * only version 2 as published by the Free Software Foundation.
 *
 * This program is distributed in the hope that it will be useful,
 * but WITHOUT ANY WARRANTY; without even the implied warranty of
 * MERCHANTABILITY or FITNESS FOR A PARTICULAR PURPOSE.  See the
 * GNU General Public License for more details.
 */

/*---------------------------------------------------------------------------
 * This file is autogenerated file using gcdb parser. Please do not edit it.
 * Update input XML file to add a new entry or update variable in this file
 * VERSION = "1.0"
 *---------------------------------------------------------------------------*/
&mdss_mdp {
	dsi_truly_1080_vid: qcom,mdss_dsi_truly_1080p_video {
		qcom,mdss-dsi-panel-name = "truly 1080p video mode dsi panel";
		qcom,mdss-dsi-panel-controller = <&mdss_dsi0>;
		qcom,mdss-dsi-panel-type = "dsi_video_mode";
		qcom,mdss-dsi-panel-destination = "display_1";
		qcom,mdss-dsi-panel-framerate = <60>;
		qcom,mdss-dsi-virtual-channel-id = <0>;
		qcom,mdss-dsi-stream = <0>;
		qcom,mdss-dsi-panel-width = <1080>;
		qcom,mdss-dsi-panel-height = <1920>;
		qcom,mdss-dsi-h-front-porch = <96>;
		qcom,mdss-dsi-h-back-porch = <64>;
		qcom,mdss-dsi-h-pulse-width = <16>;
		qcom,mdss-dsi-h-sync-skew = <0>;
		qcom,mdss-dsi-v-back-porch = <16>;
		qcom,mdss-dsi-v-front-porch = <4>;
		qcom,mdss-dsi-v-pulse-width = <1>;
		qcom,mdss-dsi-h-left-border = <0>;
		qcom,mdss-dsi-h-right-border = <0>;
		qcom,mdss-dsi-v-top-border = <0>;
		qcom,mdss-dsi-v-bottom-border = <0>;
		qcom,mdss-dsi-bpp = <24>;
		qcom,mdss-dsi-underflow-color = <0xff>;
		qcom,mdss-dsi-border-color = <0>;
		qcom,mdss-dsi-on-command = [15 01 00 00 00 00 02 35 00
			15 01 00 00 00 00 02 51 ff
			15 01 00 00 00 00 02 53 2c
			15 01 00 00 00 00 02 55 03
			05 01 00 00 c8 00 02 29 00
			23 01 00 00 00 00 02 b0 00
			29 01 00 00 00 00 07 b3 14 00 00 00 00 00
			29 01 00 00 00 00 03 B6 3A d3
			29 01 00 00 00 00 03 C0 00 00
			29 01 00 00 00 00 23 C1 84 60 10 EB FF 6F CE FF FF 17 02
				58 73 AE B1 20 C6 FF FF 1F F3 FF 5F 10 10 10 10 00 02 01
				22 22 00 01
			29 01 00 00 00 00 08 C2 31 F7 80 06 08 00 00
			29 01 00 00 00 00 17 C4 70 00 00 00 00 04 00 00 00 0C 06
				00 00 00 00 00 04 00 00 00 0C 06
			29 01 00 00 00 00 29 C6 00 69 00 69 00 69 00 00 00 00 00
				69 00 69 00 69 10 19 07 00 01 00 69 00 69 00 69 00 00 00
				00 00 69 00 69 00 69 10 19 07
			29 01 00 00 00 00 0a CB 31 FC 3F 8C 00 00 00 00 C0
			23 01 00 00 00 00 02 cc 0b
			29 01 00 00 00 00 0b D0 11 81 BB 1E 1E 4C 19 19 0C 00
			29 01 00 00 00 00 1a D3 1B 33 BB BB B3 33 33 33 00 01 00
				A0 D8 A0 0D 4E 4E 33 3B 22 72 07 3D BF 33
			29 01 00 00 00 00 08 D5 06 00 00 01 51 01 32
			29 01 00 00 00 00 1f C7 01 0A 11 18 26 33 3E 50 38 42 52
				60 67 6E 77 01 0A 11 18 26 33 3E 50 38 42 52 60 67 6E 77
			29 01 00 00 c8 00 14 C8 01 00 00 00 00 FC 00 00 00 00 00 FC
				00 00 00 00 00 FC 00
			05 01 00 00 c8 00 02 11 00];
		qcom,mdss-dsi-off-command = [05 01 00 00 96 00 02 28 00
				 05 01 00 00 96 00 02 10 00];
		qcom,mdss-dsi-on-command-state = "dsi_lp_mode";
		qcom,mdss-dsi-off-command-state = "dsi_lp_mode";
		qcom,mdss-dsi-h-sync-pulse = <0>;
		qcom,mdss-dsi-traffic-mode = "burst_mode";
		qcom,mdss-dsi-bllp-eof-power-mode;
		qcom,mdss-dsi-bllp-power-mode;
		qcom,mdss-dsi-lane-0-state;
		qcom,mdss-dsi-lane-1-state;
		qcom,mdss-dsi-lane-2-state;
		qcom,mdss-dsi-lane-3-state;
		qcom,mdss-dsi-panel-timings = [e6 38 26 00 68 6e 2a 3c 44 03 04	00];
		qcom,mdss-dsi-t-clk-post = <0x02>;
		qcom,mdss-dsi-t-clk-pre = <0x2d>;
		qcom,mdss-dsi-bl-min-level = <1>;
		qcom,mdss-dsi-bl-max-level = <4095>;
		qcom,mdss-dsi-dma-trigger = "trigger_sw";
		qcom,mdss-dsi-mdp-trigger = "none";
		qcom,mdss-dsi-bl-pmic-control-type = "bl_ctrl_wled";
		qcom,mdss-dsi-reset-sequence = <1 200>, <0 200>, <1 200>;
	};
};
