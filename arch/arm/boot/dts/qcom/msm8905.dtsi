/*
 * Copyright (c) 2017, The Linux Foundation. All rights reserved.
 *
 * This program is free software; you can redistribute it and/or modify
 * it under the terms of the GNU General Public License version 2 and
 * only version 2 as published by the Free Software Foundation.
 *
 * This program is distributed in the hope that it will be useful,
 * but WITHOUT ANY WARRANTY; without even the implied warranty of
 * MERCHANTABILITY or FITNESS FOR A PARTICULAR PURPOSE.  See the
 * GNU General Public License for more details.
 */

/ {
	model = "Qualcomm Technologies, Inc. MSM8905";
	qcom,msm-id = <331 0>;

	cpus {
		/delete-node/ cpu@2;
		/delete-node/ cpu@3;
	};
};

&soc {
	/delete-node/ jtagmm@84e000;
	/delete-node/ jtagmm@84f000;
	/delete-node/ qcom,spm@b0a9000;
	/delete-node/ qcom,spm@b0b9000;
	/delete-node/ cti@853000;
	/delete-node/ cti@854000;
	/delete-node/ etm@84e000;
	/delete-node/ etm@84f000;
};

&msm_gpu {
	/* Disable GPU snapshot dumping */
	qcom,snapshot-size = <0>;
};
