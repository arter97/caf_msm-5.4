/*
 * Copyright (c) 2017, The Linux Foundation. All rights reserved.
 *
 * This program is free software; you can redistribute it and/or modify
 * it under the terms of the GNU General Public License version 2 and
 * only version 2 as published by the Free Software Foundation.
 *
 * This program is distributed in the hope that it will be useful,
 * but WITHOUT ANY WARRANTY; without even the implied warranty of
 * MERCHANTABILITY or FITNESS FOR A PARTICULAR PURPOSE.  See the
 * GNU General Public License for more details.
 */

&modem_adsp_mem {
	reg = <0x0 0x88000000 0x0 0x04600000>;
};

&peripheral_mem {
	reg = <0x0 0x8c600000 0x0 0x0500000>;
};

&venus_qseecom_mem {
	reg = <0 0 0 0x400000>;
};
