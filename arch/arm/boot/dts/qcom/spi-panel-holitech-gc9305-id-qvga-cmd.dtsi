/* Copyright (c) 2017, The Linux Foundation. All rights reserved.
 *
 * This program is free software; you can redistribute it and/or modify
 * it under the terms of the GNU General Public License version 2 and
 * only version 2 as published by the Free Software Foundation.
 *
 * This program is distributed in the hope that it will be useful,
 * but WITHOUT ANY WARRANTY; without even the implied warranty of
 * MERCHANTABILITY or FITNESS FOR A PARTICULAR PURPOSE.  See the
 * GNU General Public License for more details.
 */

&mdss_mdp {
        spi_holitech_gc9305_ic_qvga_cmd: qcom,mdss_spi_holitech_gc9305_id_qvga_cmd {
                qcom,mdss-spi-panel-name = "holitech gc9305 id qvga command mode spi panel";
                qcom,mdss-spi-panel-destination = "display_1";
                qcom,mdss-spi-panel-controller = <&mdss_spi>;
                qcom,mdss-spi-panel-framerate = <30>;
                qcom,mdss-spi-panel-width = <240>;
                qcom,mdss-spi-panel-height = <320>;
                qcom,mdss-spi-h-front-porch = <79>;
                qcom,mdss-spi-h-back-porch = <59>;
                qcom,mdss-spi-h-pulse-width = <60>;
                qcom,mdss-spi-v-back-porch = <10>;
                qcom,mdss-spi-v-front-porch = <7>;
                qcom,mdss-spi-v-pulse-width = <2>;
                qcom,mdss-spi-h-left-border = <0>;
                qcom,mdss-spi-h-right-border = <0>;
                qcom,mdss-spi-v-top-border = <0>;
                qcom,mdss-spi-v-bottom-border = <0>;
                qcom,mdss-spi-bpp = <16>;
                qcom,mdss-spi-on-command = [
                    00 01 FE
                        00 01 EF
                        00 02 36 48
                        00 02 3A 05
                        00 03 A4 44 44
                        00 03 A5 42 42
                        00 03 AA 88 88
                        00 03 E8 21 0b
                        00 03 E3 01 18
                        00 03 E1 10 0a          
                        00 02 AC 00
                        00 03 A6 29 29
                        00 03 A7 27 27
                        00 03 A8 17 17
                        00 03 A9 26 26
                        00 02 AF 67
                        00 05 2A 00 00 00 EF
                        00 05 2B 00 00 01 3F
                        00 07 F0 02 02 00 03 09 0C
                        00 07 F1 01 03 00 04 12 13
                        00 07 F2 0C 07 34 03 04 46
                        00 07 F3 14 0B 42 04 05 50
                        00 07 F4 09 13 13 1E 22 0F
                        00 07 F5 08 0E 0E 22 2B 0F
                        00 02 35 00
                        00 03 44 00 14
                        78 01 11
                        00 01 29
                        00 01 2C
                        ];
                qcom,mdss-spi-off-command = [20 01 28
                                 20 01 10];
                qcom,mdss-spi-esd-command = [00 01 20
                                 00 02 36 48
                                 00 02 3a 05
                                 00 01 2c];             
                qcom,mdss-spi-bl-min-level = <1>;
                qcom,mdss-spi-bl-max-level = <16>;
                qcom,mdss-spi-reset-sequence = <1 20>, <0 10>, <1 120>;

                qcom,mdss-spi-bl-pmic-control-type = "bl_ctrl_pwm";
                qcom,mdss-spi-bl-pmic-pwm-frequency = <100>;
                qcom,mdss-spi-bl-pmic-bank-select = <0>;
                qcom,mdss-spi-pwm-gpio = <&pm8909_mpps 2 0>;
                qcom,cont-splash-enabled;               
        };
};
