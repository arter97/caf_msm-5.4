## Documentation/devicetree/bindings/arm/msm/cpuss-csr.txt
```
CPUSS CSR

This device encapsulates the CPU subsystem domain level Control Status Registers.
Information that may be obtained includes the hardware revision for the CPU subsystem.

compatible: 	 Must be "qcom,msm8996-cpss-csr"
reg:		 Specifies the physical base address and size of the memory region
		 where the CPUSS CSR registers reside
Example:

	cpuss_csr: cpuss-csr@09820000 {
		compatible = "qcom,msm8996-cpuss-csr";
		reg = <0x09820000 0x10000>;
	};

	cpu0: cpu@0: {
	      ...
	      qcom,cpuss-csr = <&cpuss_csr>;
	      ...
	};
```

## Documentation/devicetree/bindings/arm/msm/cpuss-pm.txt
```
CPUSS-PM

This device encapsulates the Global Power Management registers of the CPU subsystem
power domain which houses power control and delay configuration registers for power
mode switches.

compatible:	Must be "qcom,msm8996-cpuss-pm"
reg:		Specifies physical base address for the CPUSS Global PM registers
		and the size of the memory region

Example:

	cpuss_pm: cpuss-pm@099e0000 {
		compatible = "qcom,msm8996-cpuss-pm";
		reg = <0x099e0000 0x1000>;
	};

	cpu0: cpu@0: {
	      ...
	      qcom,cpuss-pm = <&cpuss_pm>;
	      ...
	};
```

## Documentation/devicetree/bindings/arm/msm/l2ccc.txt
```
L2 Cache Clock Controller

The L2 Cache Clock Controller provides clock, power domain, and
reset control to a L2-cache for a cluster. There is L2CCC register
region per CPU Cluster.

Required properties:
- compatible:	Can be one of:
		"qcom,8994-l2ccc"
		"qcom,8916-l2ccc"
		"qcom,msm8996-l2ccc"
- reg:		This specifies the base address and size of
		the register region.

Optional properties:
- reg:		For "qcom,8994-l2ccc only", an optional second tuple specifies
		the shared common base address required to trigger the L2 SPM
		out of power collapse.
		For "qcom,msm8996-l2ccc" only, an optional second tuple
		specifies the address of the CLKSEL register for the cluster.
- qcom,cbf-clock-peer: For "qcom,msm8996-l2ccc" only, a phandle to a peer
                "qcom,msm8996-l2ccc" node, which shares a common CBF clock
		source.
- qcom,cbf-clock-seq: For "qcom,msm8996-l2ccc" only, specify this to
		temporarily select the CBF clock source while powering up the
		L2. If present, the CLKSEL "reg" tuple must also be specified
		for this node and in the "cbf-clock-peer" node.  The
		"cbf-clock-peer" node is required in such cases, as well.
- qcom,vctl-node: Reference to a node that controls the power rails for the
 cluster.
- qcom,vctl-val: The voltage control register value that must be set before
		the caches can be turned on. This would be a required property
		if the target necessitates a voltage rail be turned on before
		turning on the cache.
- qcom,clamped-reset-seq: For "qcom,msm8996-l2ccc" only, specify this to
		apply an alternate L2 reset sequence, which repeatedly toggles
		the reset signal while clamps are enabled.

Example:

	clock-controller@f900f000 {
		compatible = "qcom,8994-l2ccc"";
		reg = <0xf900f000 0x1000>,
			<0xf911210c 0x4>;
		qcom,vctl-node = <&cluster_node>;
		qcom,vctl-val = <0xb8>;
	}
```

## Documentation/devicetree/bindings/arm/pmu.txt
```
* ARM Performance Monitor Units

ARM cores often have a PMU for counting cpu and cache events like cache misses
and hits. The interface to the PMU is part of the ARM ARM. The ARM PMU
representation in the device tree should be done as under:-

Required properties:

- compatible : should be one of
	"arm,armv8-pmuv3"
	"arm,cortex-a15-pmu"
	"arm,cortex-a9-pmu"
	"arm,cortex-a8-pmu"
	"arm,cortex-a7-pmu"
	"arm,cortex-a5-pmu"
	"arm,arm11mpcore-pmu"
	"arm,arm1176-pmu"
	"arm,arm1136-pmu"
	"qcom,krait-pmu"
- interrupts : 1 combined interrupt or 1 per core.
- cluster : a phandle to the cluster to which it belongs
	If there are more than one cluster with same CPU type
	then there should be separate PMU nodes per cluster.

Optional:
- qcom,irq-is-percpu:   Define this if the IRQ of the PMU is a PPI. This will tell perf to use
			the per_cpu IRQ API for request and free.

Example:

pmu {
        compatible = "arm,cortex-a9-pmu";
        interrupts = <100 101>;
};

For the L2CC PMU:
If the L2 cache controller PMU is available, its DT bindings should be defined as
follows.

Required Properties:

- compatible: Should be "qcom,l2-pmu"
- interrupts : 1 combined interrupt.

Example:

  l2-pmu {
                compatible = "qcom,l2-pmu";
                interrupts = <0 1 0>;
        };
```

## Documentation/devicetree/bindings/input/touchscreen/gt9xx/gt9xx.txt
```
Goodix GT9xx series touch controller

Required properties:

 - compatible		: Should be "goodix,gt9xx"
 - reg			: I2C slave address of the device.
 - interrupt-parent	: Parent of interrupt.
 - interrupts		: Configuration of touch panel controller interrupt
				GPIO.
 - goodix,family-id	: Family identification of the controller.
 - goodix,irq-gpio	: IRQ gpio which is to provide interrupts to host,
				same as "interrupts" node. It will also.
				contain active low or active high information.
 - goodix,reset-gpio	: Reset gpio to control the reset of chip.
 - goodix,display-coords	: Display coordinates in pixels. It is a four
				tuple consisting of min x, min y, max x and
				max y values.

Optional properties:

 - vdd-supply		: Power supply needed to power up the device, when use
				external LDO supply, do not add this property.
 - vcc_i2c-supply	: Power source required to power up i2c bus.
				GT9xx series can provide 1.8V from internal
				LDO, add this properties base on hardware
				design.
 - goodix,ldo-en-gpio	: Some design use external LDO to power the device,
				this properties configure the LDO enabling
				GPIO.
 - goodix,panel-coords	: Panel coordinates for the chip in pixels.
				It is a four tuple consisting of min x,
				min y, max x and max y values.
 - goodix,i2c-pull-up	: To specify pull up is required.
 - goodix,no-force-update	: To specify force update is allowed.
 - goodix,button-map	: Button map of key codes. The number of key codes
				depend on panel.
 - goodix,cfg-data	: Touchpanel controller configuration data, ask vendor
				to provide that. Default configuration will be
				used if this property is not present.

Example:
i2c@f9927000 {
		goodix@5d {
			compatible = "goodix,gt9xx";
			reg = <0x5d>;
			interrupt-parent = <&msmgpio>;
			interrupts = <17 0x2008>;
			goodix,reset-gpio = <&msmgpio 16 0x00>;
			goodix,irq-gpio = <&msmgpio 17 0x00>;
			goodix,ldo-en-gpio = <&msmgpio 15 0x00>;
			goodix,panel-coords = <0 0 720 1200>;
			goodix,display-coords = <0 0 720 1080>;
			goodix,button-map= <158 102 139>;
			goodix,family-id = <0x0>;
		};
};
```

## Documentation/devicetree/bindings/media/video/msm-camera-flash.txt
```
* Qualcomm MSM CAMERA FLASH

Required properties:
- cell-index : Should contain flash source index to diffentiate
    between different flash devices. These indexes represent flash devices
    for multiple sensors.
    - 0, 1, 2, 3
- compatible :
    - "qcom,camera-led-flash"
    - "qcom,led-flash"
- qcom,flash-type : Should contain type flash device
    - 1 for LED flash
    - 2 for strobe flash
- qcom,flash-source : Should contain array of phandles to flash source nodes.
    - pm8941_flash0 pm8941_flash1
- qcom,gpio-flash-en : Should contain gpio array index gpio flash enable pin
- qcom,gpio-flash-now : Should contain gpio array index gpio flash now pin

Example:

qcom,camera-led-flash {
	cell-index = <0>;
	compatible = "qcom,camera-led-flash";
	qcom,flash-type = <1>;
	qcom,flash-source = <&pm8941_flash0 &pm8941_flash1>;
};

qcom,led-flash@60 {
	cell-index = <0>;
	reg = <0x60>;
	qcom,slave-id = <0x60 0x00 0x0011>;
	compatible = "qcom,led-flash";
	qcom,flash-name = "adp1600";
	qcom,flash-type = <1>;
	qcom,gpio-no-mux = <0>;
	gpios = <&msmgpio 18 0>,
		<&msmgpio 19 0>;
	qcom,gpio-flash-en = <0>;
	qcom,gpio-flash-now = <1>;
	qcom,gpio-req-tbl-num = <0 1>;
	qcom,gpio-req-tbl-flags = <0 0>;
	qcom,gpio-req-tbl-label = "FLASH_EN",
			"FLASH_NOW";
};
```

## Documentation/devicetree/bindings/media/video/msm-camera-led-gpio.txt
```
* Qualcomm MSM CAMERA LED GPIO

LED triggered by a single GPIO.

Required properties:
- cell-index : Should contain source index to diffentiate
    between different LED devices. These indexes represent LED devices
    for multiple LEDs.
    - 0, 1, 2, 3
- compatible :
    - "qcom,led-gpio-flash"
    - "qcom,led-gpio-ir"
- gpios : should contain phandle to gpio controller node and one
    #gpio-cells specifying specific gpio (controller specific)
- qcom,gpio-req-tbl-num : should contain index to gpio specific to this LED
- qcom,gpio-req-tbl-flags : should contain direction of gpio present in
    qcom,gpio-req-tbl-num property
- qcom,gpio-req-tbl-label : should contain name of gpio present in
    qcom,gpio-req-tbl-num property

Example:
	qcom,led-ir {
		cell-index = <0>;
		compatible = "qcom,led-gpio-ir";
		label = "led-ir-label";
		gpios = <&msm_gpio 31 0>;
		qcom,gpio-req-tbl-num = <0>;
		qcom,gpio-req-tbl-flags = <0>;
		qcom,gpio-req-tbl-label = "LED_IR_EN";
	};
```

## Documentation/devicetree/bindings/net/neutrino2_avb.txt
```
* Neutrino2 Ethernet *

This driver implements Ethernet driver for Neutrino2 ethernet controller

Required properties:
  - compatible: Should be "qcom,ntn2_avb"
  - ntn-rc-num: PCIe root complex number on which Neutrino is connected

Optional properties:
  - ntn-supply-enable-gpio: GPIO used to control power supply to Neutrino
  - qcom,ntn-disable-phy: Use for devices that don't have a PHY chip
  - qcom,ntn-mac-port-speed: MAC port speed 10Mbps/100Mbps/1000Mbps applicable
                            when qcom,ntn-disable-phy is enabled

Example:
	qcom,ntn2_avb {
		compatible = "qcom,ntn2_avb";
		ntn-supply-enable-gpio = <&pmd9635_gpios 3 0>;
		qcom,ntn-rc-num = <0>;
	};
```

## Documentation/devicetree/bindings/nfc/ese.txt
```
Qualcomm Technologies, Inc NQ-ESE SPI device

QTI Secure Element Driver for Secure transactions

Required properties:

- compatible: "qcom,ese"
- pinctrl-names, pinctrl-0, pincntrl-1: references to our pincntrl settings

Optional properties:
- spi-max-frequency : Frequency to be set according to the ese specification.
- spi-cpol : clock polarity to be set according to the ese specification.
- spi-cpha : clock phase to be set according to the ese specification.
- qcom,ese_intr : gpio for ese interrupt
- qcom,ese_pwr_req : gpio for ese power

Example:

		ese@0 {
			compatible = "qcom,ese";
			reg = <0>;
			spi-max-frequency = <960000>;
			spi-cpol = <0>;
			spi-cpha =<0>;
			/* if no pwr req this must be 0 else 1*/
			qcom,use_pwr_req = <1>;
			qcom,ese_pwr_req = <&msm_gpio 31 0x00>;
			/* if no intr req this must be 0 else 1*/
			qcom,use_interrupt = <1>;
			qcom,ese_intr = <&msm_gpio 35 0x00>;
			pinctrl-names = "ese_active", "ese_suspend";
			pinctrl-0 = <&ese_int_active>;
			pinctrl-1 = <&ese_int_suspend>;
		};
```

## Documentation/devicetree/bindings/ontario/ontario.txt
```
* ONTARIO (Qualcomm Technologies, Inc. SenseID clock control driver )

Required properties:
- compatible : Should be "qcom,ontario"
- qcom, msm_clk,name: Should be "clk_gcc_blsp2_qup2_spi_apps_clk"
- qcom, msm_bus,name: Should be "clk_gcc_blsp2_ahb_clk"

Example:
    qcom,ontario@7000000 {
        compatible = "qcom,ontario";
        clocks = <&clock_gcc clk_gcc_blsp2_qup2_spi_apps_clk>,
        <&clock_gcc clk_gcc_blsp2_ahb_clk>;
        clock-names = "spi_clk", "ahb_clk";
    };
```

## Documentation/devicetree/bindings/pinctrl/qcom,apq8084-pinctrl.txt
```
Qualcomm APQ8084 TLMM block

Required properties:
- compatible: "qcom,apq8084-pinctrl"
- reg: Should be the base address and length of the TLMM block.
- interrupts: Should be the parent IRQ of the TLMM block.
- interrupt-controller: Marks the device node as an interrupt controller.
- #interrupt-cells: Should be two.
- gpio-controller: Marks the device node as a GPIO controller.
- #gpio-cells : Should be two.
                The first cell is the gpio pin number and the
                second cell is used for optional parameters.

Please refer to ../gpio/gpio.txt and ../interrupt-controller/interrupts.txt for
a general description of GPIO and interrupt bindings.

Please refer to pinctrl-bindings.txt in this directory for details of the
common pinctrl bindings used by client devices, including the meaning of the
phrase "pin configuration node".

Qualcomm's pin configuration nodes act as a container for an abitrary number of
subnodes. Each of these subnodes represents some desired configuration for a
pin, a group, or a list of pins or groups. This configuration can include the
mux function to select on those pin(s)/group(s), and various pin configuration
parameters, such as pull-up, drive strength, etc.

The name of each subnode is not important; all subnodes should be enumerated
and processed purely based on their content.

Each subnode only affects those parameters that are explicitly listed. In
other words, a subnode that lists a mux function but no pin configuration
parameters implies no information about any pin configuration parameters.
Similarly, a pin subnode that describes a pullup parameter implies no
information about e.g. the mux function.


The following generic properties as defined in pinctrl-bindings.txt are valid
to specify in a pin configuration subnode:

 pins, function, bias-disable, bias-pull-down, bias-pull-up, drive-strength,
 output-low, output-high.

Non-empty subnodes must specify the 'pins' property.
Note that not all properties are valid for all pins.

Valid values for pins are:
  gpio0-gpio146
    Supports mux, bias and drive-strength

  sdc1_clk, sdc1_cmd, sdc1_data, sdc2_clk, sdc2_cmd, sdc2_data
    Supports bias and drive-strength

Valid values for function are:
adsp_ext, audio_ref, blsp_i2c1, blsp_i2c2, blsp_i2c3, blsp_i2c4, blsp_i2c5,
blsp_i2c6, blsp_i2c7, blsp_i2c8, blsp_i2c9, blsp_i2c10, blsp_i2c11, blsp_i2c12,
blsp_spi1, blsp_spi2, blsp_spi3, blsp_spi4, blsp_spi5, blsp_spi6, blsp_spi7,
blsp_spi8, blsp_spi9, blsp_spi10, blsp_spi11, blsp_spi12, blsp_uart1,
blsp_uart2, blsp_uart3, blsp_uart4, blsp_uart5, blsp_uart6, blsp_uart7,
blsp_uart8, blsp_uart9, blsp_uart10, blsp_uart11, blsp_uart12, blsp_uim1,
blsp_uim2, blsp_uim3, blsp_uim4, blsp_uim5, blsp_uim6, blsp_uim7, blsp_uim8,
blsp_uim9, blsp_uim10, blsp_uim11, blsp_uim12, cam_mclk0, cam_mclk1, cam_mclk2,
cam_mclk3, cci_async, cci_async_in0, cci_i2c0, cci_i2c1, cci_timer0, cci_timer1,
cci_timer2, cci_timer3, cci_timer4, edp_hpd, gcc_gp1, gcc_gp2, gcc_gp3, gcc_obt,
gcc_vtt, gp_mn, gp_pdm0, gp_pdm1, gp_pdm2, gp0_clk, gp1_clk, gpio, hdmi_cec,
hdmi_ddc, hdmi_dtest, hdmi_hpd, hdmi_rcv, hsic, ldo_en, ldo_update, mdp_vsync,
pci_e0, pci_e0_n, pci_e0_rst, pci_e1, pci_e1_rst, pci_e1_rst_n, pci_e1_clkreq_n,
pri_mi2s, qua_mi2s, sata_act, sata_devsleep, sata_devsleep_n, sd_write,
sdc_emmc_mode, sdc3, sdc4, sec_mi2s, slimbus, spdif_tx, spkr_i2s, spkr_i2s_ws,
spss_geni, ter_mi2s, tsif1, tsif2, uim, uim_batt_alarm, gpio

Example:

	tlmm: pinctrl@fd510000 {
		compatible = "qcom,apq8084-pinctrl";
		reg = <0xfd510000 0x4000>;
		gpio-controller;
		#gpio-cells = <2>;
		interrupt-controller;
		#interrupt-cells = <2>;
		interrupts = <0 208 0>;

		pinctrl-names = "default";
		pinctrl-0 = <&uart2_default>;

		uart2_default: uart2_default {
			mux {
				pins = "gpio4", "gpio5";
				function = "blsp_uart2";
			};

			tx {
				pins = "gpio4";
				drive-strength = <4>;
				bias-disable;
			};


			rx {
				pins = "gpio5";
				drive-strength = <2>;
				bias-pull-up;
			};
		};
	};
```
