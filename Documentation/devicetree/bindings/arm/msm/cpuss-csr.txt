## arch/arm/mach-msm/Kconfig
```kconfig
if ARCH_MSM

menu "MSM SoC Type"

config ARCH_APQ8084
	bool "APQ8084"
	select ARCH_MSM_KRAITMP
	select ARM_GIC
	select MULTI_IRQ_HANDLER
	select CPU_V7
	select MSM_SCM
	select HAVE_ARM_ARCH_TIMER
	select MSM_GPIOMUX
	select MAY_HAVE_SPARSE_IRQ
	select SPARSE_IRQ
	select DEVFREQ_SIMPLE_DEV
	select KRAIT_REGULATOR
	select ARM_HAS_SG_CHAIN
	select CLKDEV_LOOKUP
	select MSM_QDSP6V2_CODECS
	select MSM_QDSP6_APRV2 if SND_SOC
	select MSM_PIL
	select QMI_ENCDEC
	select HAVE_CLK
	select HAVE_CLK_PREPARE
	select MSM_IRQ
	select PINCTRL
	select MSM_SPM
	select MSM_L2_SPM
	select MSM_PM if PM
	select ARCH_DMA_ADDR_T_64BIT if ARM_LPAE
	select ARCH_WANT_KMAP_ATOMIC_FLUSH
	select MAXIMUM_CURRENT_THROTTLING
	select MEMORY_HOLE_CARVEOUT

endmenu

config ARCH_MSM_KRAIT
	bool
	select ARM_L1_CACHE_SHIFT_6

config MSM_SMP
	bool
	select HAVE_SMP

config  ARCH_MSM_KRAITMP
	select ARCH_MSM_KRAIT
	select MSM_SMP
	bool

config MSM_SOC_REV_A
	bool

config  ARCH_MSM_ARM11
	bool

config  ARCH_MSM_SCORPION
	bool

config  MSM_VIC
	bool

config MSM_PROC_COMM
	bool

config MSM_GPIOMUX
	bool
	help
	  Support for MSM V1 TLMM GPIOMUX architecture.

config KRAIT_REGULATOR
	bool "Support Kraits powered via ganged regulators in the pmic"
	help
	 Certain MSMs have the Krait CPUs powered via a single supply
	 line from the PMIC. This supply line is powered by multiple
	 regulators running in ganged mode inside the PMIC. Enable
	 this option to support such configurations.

config MSM_CACHE_ERP
	bool "Cache / CPU error reporting"
	depends on ARCH_MSM_KRAIT
	help
	  Say 'Y' here to enable reporting of cache and TLB errors to the kernel
	  log. Enabling this feature can be used as a system debugging technique
	  if cache corruption is suspected. Cache error statistics will also be
	  reported in /proc/cpu/msm_cache_erp.

	  For production builds, you should probably say 'N' here.

config MSM_L1_ERR_PANIC
	bool "Panic on L1 cache errors"
	depends on MSM_CACHE_ERP
	help
	  To cause the kernel to panic whenever an L1 cache error is detected, say
	  'Y' here. This may be useful as a debugging technique if general system
	  instability is suspected.

	  For production builds, you should probably say 'N' here.

config MSM_L1_RECOV_ERR_PANIC
	bool "Panic on recoverable L1 cache errors"
	depends on MSM_CACHE_ERP && MSM_L1_ERR_PANIC
	help
	  Certain CPU designs may be able to automatically recover from certain
	  kinds of L1 cache errors, even though the L1 cache itself may not
	  support error correction. These errors should not result in any kind
	  of corruption, but their presence is nevertheless an indication of
	  poor system health. To cause the kernel to panic whenever a
	  recoverable L1 cache error is detected, say 'Y' here. This may be
	  useful as a debugging technique if general system instability is
	  suspected.

	  For production builds, you should definitely say 'N' here.

config MSM_L1_ERR_LOG
	bool "Log CPU ERP events to system memory"
	depends on MSM_CACHE_ERP
	help
	  Enable logging CPU ERP events to an area of memory that will be
	  preserved across a system reset. This may be useful for detecting and
	  troubleshooting ERP-related system crashes in the field.

	  For production builds, you may want to say 'Y' here.

config MSM_L2_ERP_PRINT_ACCESS_ERRORS
	bool "Report L2 master port slave/decode errors in kernel log"
	depends on MSM_CACHE_ERP
	help
	  Master port errors can occur when a memory request is not properly
	  handled by the destination slave. This can occur if the destination
	  register does not exist or is inaccessible due to security
	  restrictions or (in some cases) clock configuration. Enabling this
	  option will cause a backtrace to be printed to the kernel log whenever
	  such an error is encountered. Note that the error is reported as an
	  interrupt rather than as an exception, meaning that the backtrace may
	  have some skid. This option may help with debugging, though production
	  builds should probably say 'N' here.

config MSM_L2_ERP_PORT_PANIC
	bool "Panic on L2 master port errors"
	depends on MSM_CACHE_ERP && MSM_L2_ERP_PRINT_ACCESS_ERRORS
	help
	  Master port errors can occur when a memory request is not properly
	  handled by the destination slave. Enable this option to catch drivers
	  which attempt to access bad areas of the address space, or access
	  hardware registers in an improper state (such as certain clocks not
	  being on). This option may help with debugging, though production
	  builds should probably say 'N' here.

config MSM_L2_ERP_1BIT_PANIC
	bool "Panic on recoverable L2 soft errors"
	depends on MSM_CACHE_ERP
	help
	  Enable this option to cause a kernel panic whenever the L2 cache
	  encounters a single-bit (correctable) soft error. This option should
	  only be enabled when doing low-level debugging where cache corruption
	  is suspected.

	  For production builds, you should definitely say 'N' here.

config MSM_L2_ERP_2BIT_PANIC
	bool "Panic on unrecoverable L2 soft errors"
	depends on MSM_CACHE_ERP
	help
	  Enable this option to cause a kernel panic whenever the L2 cache
	  encounters a double-bit (non-correctable) soft error. Debug builds
	  will likely benefit from having this option enabled to catch cache
	  problems as soon as possible.

	  For production builds, it may be acceptable to say 'N' here, since
	  an uncorrectable error might not necessarily cause further problems.

config MSM_HSIC_SYSMON
	tristate "MSM HSIC system monitor driver"
	depends on USB
	help
	 Add support for bridging with the system monitor interface of MDM
	 over HSIC. This driver allows the local system monitor to
	 communicate with the remote system monitor interface.

config MSM_HSIC_SYSMON_TEST
	tristate "MSM HSIC system monitor bridge test"
	depends on USB && MSM_HSIC_SYSMON && DEBUG_FS
	help
	  Enable the test hook for the Qualcomm system monitor HSIC driver.
	  This will create a debugfs file entry named "hsic_sysmon_test" which
	  can be read and written to send character data to the sysmon port of
	  the modem over USB.

config MSM_TEST_QMI_CLIENT
	depends on MSM_QMI_INTERFACE
	bool "MSM TEST QMI CLIENT"
	help
	  The sample QMI client provides a test code for QMI usage. The
	  test_service client driver uses QMI interface library to send
	  and receive QMI messages over IPC Router. The test code sends
	  a synchronous QMI request to the test_service and handles the
	  QMI responses.
endif
```

## drivers/button/Kconfig
```kconfig
config BUTTON
tristate "Button driver to handle key events"
default y
help
  BUTTON module
```

## drivers/buzzer/Kconfig
```kconfig
#
# BUZZER configuration
#

menu "Buzzer support"

config BUZZER
	bool "GPIO Driven Buzzer"
	help
	  Buzzer support

endmenu
```

## drivers/irqchip/Kconfig
```kconfig
config IRQCHIP
	def_bool y
	depends on OF_IRQ

config ARM_GIC
	bool
	select IRQ_DOMAIN
	select MULTI_IRQ_HANDLER
	select MSM_SHOW_RESUME_IRQ

config GIC_NON_BANKED
	bool

config ARM_GIC_V3
	bool
	select IRQ_DOMAIN
	select MULTI_IRQ_HANDLER

config ARM_NVIC
	bool
	select IRQ_DOMAIN
	select GENERIC_IRQ_CHIP

config ARM_VIC
	bool
	select IRQ_DOMAIN
	select MULTI_IRQ_HANDLER

config ARM_VIC_NR
	int
	default 4 if ARCH_S5PV210
	default 3 if ARCH_S5PC100
	default 2
	depends on ARM_VIC
	help
	  The maximum number of VICs available in the system, for
	  power management.

config MSM_SHOW_RESUME_IRQ
	bool "Enable logging of interrupts that could have caused resume"
	depends on ARM_GIC
	default n
	help
	  This option logs wake up interrupts that have triggered just before
	  the resume loop unrolls. It helps to debug to know any unnecessary
	  wake up interrupts that causes system to come out of low power modes.
	  Say Y if you want to debug why the system resumed.

config MSM_GIC_SGI_NEEDS_BARRIER
	bool "SGI operations require explicit barriers"
	depends on ARM_GIC_V3
	def_bool ARCH_MSM8996
	help
	  Some early samples of the MSM8996 SoCs require that an explicit
	  barrier be executed between two sucessive writes to the ICC_SGI1R_EL1
	  register. If you are building the kernel to work on one of these early
	  designs, select 'Y' here.

	  For production kernels, you should say 'N' here.

config DW_APB_ICTL
	bool
	select IRQ_DOMAIN

config IMGPDC_IRQ
	bool
	select GENERIC_IRQ_CHIP
	select IRQ_DOMAIN

config ORION_IRQCHIP
	bool
	select IRQ_DOMAIN
	select MULTI_IRQ_HANDLER

config RENESAS_INTC_IRQPIN
	bool
	select IRQ_DOMAIN

config RENESAS_IRQC
	bool
	select IRQ_DOMAIN

config TB10X_IRQC
	bool
	select IRQ_DOMAIN
	select GENERIC_IRQ_CHIP

config VERSATILE_FPGA_IRQ
	bool
	select IRQ_DOMAIN

config VERSATILE_FPGA_IRQ_NR
       int
       default 4
       depends on VERSATILE_FPGA_IRQ

config XTENSA_MX
	bool
	select IRQ_DOMAIN

config MSM_IRQ
	bool
	select IRQ_DOMAIN
```

## drivers/media/platform/msm/Kconfig
```kconfig
source "drivers/media/platform/msm/vidc/Kconfig"
source "drivers/media/platform/msm/wfd/Kconfig"
source "drivers/media/platform/msm/broadcast/Kconfig"
source "drivers/media/platform/msm/vpu/Kconfig"
```

## drivers/media/platform/msm/cvp2.0/Kconfig
```kconfig
# SPDX-License-Identifier: GPL-2.0-only
#
# CVP CORE
#

menuconfig MSM_CVP_V2
	tristate "MSM CVP2.0 driver"
        help
          Enable support of MSM CVP2.0 driver for
          Qualcomm Technologies, Inc.
```

## drivers/media/virtio/Kconfig
```kconfig
config VIRTIO_VIDEO
	tristate "Virtio multi-format V4L2 encoder/decoder driver"
	depends on VIDEO_V4L2 && VIRTIO && MMU
	select VIDEOBUF2_DMA_CONTIG
	select VIDEOBUF2_DMA_SG
	select V4L2_MEM2MEM_DEV
	help
	  This is a driver for virtio V4L2 video device.
	  Enables guest access to host shared hw video accelerator.
	  If unsure, say N.
```

## drivers/misc/usb_detect/Kconfig
```kconfig
#
# Kconfig for usb detect
#
config USB_DETECT
	tristate "usb detect driver"
	default y
	help
		The driver of usb_detect is used to report the usb ID status.
```

## drivers/net/ethernet/msm/Kconfig
```kconfig
#
# msm network device configuration
#

config MSM_RMNET_BAM
	bool "RMNET BAM Driver"
	depends on (MSM_BAM_DMUX && NET_SCHED && NET_SCH_HTB && NET_SCH_PRIO && NET_CLS_FW)
	default n
	help
	  Implements RMNET over BAM interface.
	  RMNET provides a virtual ethernet interface
	  for routing IP packets within the MSM using
	  BAM as a physical transport.

config MSM_RMNET_DEBUG
	bool "MSM RMNET debug interface"
	depends on MSM_RMNET
	default n
	help
	  Debug stats on wakeup counts.
```

## drivers/net/wireless/cnss/Kconfig
```kconfig
config CNSS_SDIO
	tristate "CNSS driver for wifi module"
	---help---
	This module specifies whether CNSS Platform Driver supports SDIO.
	This flag needs to be disabled if CNSS platform Driver need to be
	supported for other buses.
```
