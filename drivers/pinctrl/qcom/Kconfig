## drivers/pinctrl/qcom/Kconfig
```kconfig
config PINCTRL_WCD
        tristate "Qualcomm Technologies, Inc WCD pin controller driver"
        depends on WCD934X_CODEC
        help
        This is the pinctrl, pinmux, pinconf and gpiolib driver for the
        WCD gpio controller block.
```

## drivers/power/qcom/Kconfig
```kconfig
config MSM_NOPM
	default y if !PM
	bool
	help
	  This enables bare minimum support of power management at platform level.
	  i.e WFI
```

## drivers/soc/qcom/Kconfig
```kconfig
#
# QCOM Soc drivers
#
config QCOM_GSBI
        tristate "QCOM General Serial Bus Interface"
        depends on ARCH_QCOM
        help
          Say y here to enable GSBI support.  The GSBI provides control
          functions for connecting the underlying serial UART, SPI, and I2C
          devices to the output pins.

if ARCH_MSM


config MSM_IPC_ROUTER_SMD_XPRT
	depends on MSM_SMD
	depends on IPC_ROUTER
	bool "MSM SMD XPRT Layer"
	help
	  SMD Transport Layer that enables IPC Router communication within
	  a System-on-Chip(SoC). When the SMD channels become available,
	  this layer registers a transport with IPC Router and enable
	  message exchange.

config MSM_IPC_ROUTER_HSIC_XPRT
	depends on USB_QCOM_IPC_BRIDGE
	depends on IPC_ROUTER
	bool "MSM HSIC XPRT Layer"
	help
	  HSIC Transport Layer that enables off-chip communication of
	  IPC Router. When the HSIC endpoint becomes available, this layer
	  registers the transport with IPC Router and enable message
	  exchange.

config MSM_QDSP6_APRV2
        bool "Audio QDSP6 APRv2 support"
        depends on MSM_SMD
        help
          Enable APRv2 IPC protocol support between
          application processor and QDSP6. APR is
          used by audio driver to configure QDSP6's
          ASM, ADM and AFE.

config MSM_ADSP_LOADER
	tristate "ADSP loader support"
	select SND_SOC_MSM_APRV2_INTF
	depends on MSM_QDSP6_APRV2 || MSM_QDSP6_APRV3
	help
	  Enable ADSP image loader.
	  The ADSP loader brings ADSP out of reset
	  for the platforms that use APRv2.
	  Say M if you want to enable this module.

config MSM_QMI_INTERFACE
	depends on IPC_ROUTER
	depends on QMI_ENCDEC
	bool "MSM QMI Interface Library"
	help
	  Library to send and receive QMI messages over IPC Router.
	  This library provides interface functions to the kernel drivers
	  to perform QMI message marshaling and transport them over IPC
	  Router.

config MSM_SMD
	depends on MSM_SMEM
	bool "MSM Shared Memory Driver (SMD)"
	help
	  Support for the shared memory interprocessor communication protocol
	  which provides virual point to point serial channels between processes
	  on the apps processor and processes on other processors in the SoC.
	  Also includes support for the Shared Memory State Machine (SMSM)
	  protocol which provides a mechanism to publish single bit state
	  information to one or more processors in the SoC.

config MSM_SMD_DEBUG
	depends on MSM_SMD
	bool "MSM SMD debug support"
	help
	  Support for debugging SMD and SMSM communication between apps and
	  other processors in the SoC. Debug support primarily consists of
	  logs consisting of information such as what interrupts were processed,
	  what channels caused interrupt activity, and when internal state
	  change events occur.

config MSM_RPM_SMD
	bool "RPM driver using SMD protocol"
	help
	  RPM is the dedicated hardware engine for managing shared SoC
	  resources. This config adds driver support for using SMD as a
	  transport layer communication with RPM hardware. It also selects
	  the MSM_MPM config that programs the MPM module to monitor interrupts
	  during sleep modes.

config MSM_SMEM
	depends on REMOTE_SPINLOCK_MSM
	bool "MSM Shared Memory (SMEM)"
	help
	  Support for the shared memory interface between the various
	  processors in the System on a Chip (SoC) which allows basic
	  inter-processor communication.

config MSM_SMEM_LOGGING
	depends on MSM_SMEM
	bool "MSM Shared Memory Logger"
	help
	  Enable the shared memory logging to log the events between
	  the various processors in the system. This option exposes
	  the shared memory logger at /dev/smem_log and a debugfs node
	  named smem_log.

config MSM_SMP2P
	bool "SMSM Point-to-Point (SMP2P)"
	depends on MSM_SMEM
	help
	  Provide point-to-point remote signaling support.
	  SMP2P enables transferring 32-bit values between
	  the local and a remote system using shared
	  memory and interrupts. A client can open multiple
	  32-bit values by specifying a unique string and
	  remote processor ID.

config MSM_SMP2P_TEST
	bool "SMSM Point-to-Point Test"
	depends on MSM_SMP2P
	help
	  Enables loopback and unit testing support for
	  SMP2P. Loopback support is used by other
	  processors to do unit testing. Unit tests
	  are used to verify the local and remote
	  implementations.

config MSM_OCMEM
        bool "MSM On-Chip memory driver (OCMEM)"
        help
          Enable support for On-Chip Memory available on certain MSM chipsets.
          OCMEM is a low latency, high performance pool shared by subsystems.

config MSM_OCMEM_LOCAL_POWER_CTRL
        bool "OCMEM Local Power Control"
        depends on MSM_OCMEM
        help
          Enable direct power management of the OCMEM core by the
          OCMEM driver. By default power management is delegated to
          the RPM. Selecting this option causes the OCMEM driver to
          directly handle the various macro power transitions.

config MSM_OCMEM_DEBUG
        bool "OCMEM Debug Support"
        depends on MSM_OCMEM
        help
          Enable debug options for On-chip Memory (OCMEM) driver.
          Various debug options include memory, power and latency.
          Choosing one of these options allows debugging of each
          individual subsystem separately.

config MSM_OCMEM_NONSECURE
        bool "OCMEM Non Secure Mode"
        depends on MSM_OCMEM_DEBUG
        help
          Disable OCMEM interaction with secure processor.
          By default OCMEM is secured and accesses for each master
          is requested by the OCMEM driver. Selecting this option
          causes the OCMEM memory to be in non-secure state unless
          its locked down by the secure processor.

config MSM_OCMEM_POWER_DEBUG
        bool "OCMEM Power Debug Support"
        depends on MSM_OCMEM_DEBUG
        help
          Enable debug support for OCMEM power management.
          This adds support for verifying all power management
          related operations of OCMEM. Both local power management
          and RPM assisted power management operations are supported.

config MSM_OCMEM_DEBUG_ALWAYS_ON
        bool "Keep OCMEM always turned ON"
        depends on MSM_OCMEM_DEBUG
        help
          Always vote for all OCMEM clocks and keep all OCMEM
          macros turned ON and never allow them to be turned OFF.
          Both local power management and RPM assisted power modes
          are supported for individual macro power control operations.

config MSM_OCMEM_POWER_DISABLE
        bool "OCMEM Disable Power Control"
        depends on MSM_OCMEM
        help
          Disable all OCMEM power management.
          Skip all OCMEM power operations that turn ON or
          turn OFF the macros. Both local power management and
          RPM assisted power management operations are skipped.
          Enable this configuration if OCMEM is being exclusively
          used as GMEM or OCIMEM.

config MSM_SUBSYSTEM_RESTART
	bool "MSM Subsystem Restart"
	help
	  This option enables the MSM subsystem restart framework.

	  The MSM subsystem restart framework provides support to boot,
	  shutdown, and restart subsystems with a reference counted API.
	  It also notifies userspace of transitions between these states via
	  sysfs.


config MSM_PIL
	bool "Peripheral image loading"
	select FW_LOADER
	default n
	help
	  Some peripherals need to be loaded into memory before they can be
	  brought out of reset.

	  Say yes to support these devices.

config MSM_PIL_SSR_GENERIC
	tristate "MSM Subsystem Boot Support"
	depends on MSM_PIL && MSM_SUBSYSTEM_RESTART
	help
	  Support for booting and shutting down MSM Subsystem processors.
	  This driver also monitors the SMSM status bits and the watchdog
	  interrupt for the subsystem and restarts it on a watchdog bite
	  or a fatal error. Subsystems include LPASS, Venus, VPU, WCNSS and
	  BCSS.

config MSM_SCM
	bool "Secure Channel Manager (SCM) support"
	default n

config MSM_WATCHDOG_V2
	bool "MSM Watchdog Support"
	help
	  This enables the watchdog module. It causes kernel panic if the
	  watchdog times out. It allows for detection of cpu hangs and
	  deadlocks. It does not run during the bootup process, so it will
	  not catch any early lockups.

endif # ARCH_MSM
```

## drivers/soc/qcom/hab/Kconfig
```kconfig
# SPDX-License-Identifier: GPL-2.0-only
#
# HAB configuration
#
config MSM_HAB
	bool "Enable Multimedia driver Hypervisor Abstraction Layer"
	select WANT_DEV_COREDUMP
	help
	  Multimedia driver hypervisor abstraction layer.
	  Required for drivers to use the HAB API to communicate with the host
	  OS.

config MSM_HAB_DEFAULT_VMID
	int
	default 2
	help
	  The default HAB VMID.
	  It will not be used when there are some other configuration sources,
	  e.g., device tree.
```
